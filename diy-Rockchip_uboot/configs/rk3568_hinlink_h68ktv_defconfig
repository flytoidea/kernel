## diy-Rockchip_uboot/configs/rk3568_hinlink_h68ktv_defconfig
```kconfig
CONFIG_ARM64=y
CONFIG_ARCH_ROCKCHIP=y
CONFIG_ROCKCHIP_RK3568=y
CONFIG_SYS_SOC="rk3568"
CONFIG_SPL_LIBCOMMON_SUPPORT=y
CONFIG_SPL_LIBGENERIC_SUPPORT=y
CONFIG_NR_DRAM_BANKS=2
CONFIG_DEFAULT_DEVICE_TREE="rk3568-hinlink-h68ktv"
CONFIG_TARGET_EVB_RK3568=y
CONFIG_SYS_TEXT_BASE=0x00200000
CONFIG_SYS_LOAD_ADDR=0x0
CONFIG_DEBUG_UART=y
CONFIG_DEBUG_UART_BASE=0xfef50000
CONFIG_DEBUG_UART_CLOCK=24000000
CONFIG_DEBUG_UART_SHIFT=2
CONFIG_ENV_SIZE=0x8000
CONFIG_ENV_OFFSET=0x3f8000
CONFIG_ENV_SECT_SIZE=0x10000
CONFIG_CMD_MMC=y
CONFIG_MMC=y
CONFIG_ROCKCHIP_DWMMC=y
CONFIG_ROCKCHIP_SDHCI=y
CONFIG_CMD_USB=y
CONFIG_USB=y
CONFIG_USB_EHCI_HCD=y
CONFIG_USB_OHCI_HCD=y
CONFIG_USB_DWC2=y
CONFIG_USB_STORAGE=y
CONFIG_CMD_NET=y
CONFIG_NET=y
CONFIG_ETH_DESIGNWARE=y
CONFIG_ROCKCHIP_GMAC=y
CONFIG_PHY_GIGE=y
CONFIG_PCI=y
CONFIG_DM_PCI=y
CONFIG_PCIE_DW_ROCKCHIP=y
CONFIG_PHY_ROCKCHIP_SNPS_PCIE3=y
CONFIG_CMD_PCI=y
CONFIG_SYSRESET=y
CONFIG_BOOTDELAY=3
CONFIG_BOOTCOMMAND="pci enum; run boot_usb; run boot_mmc1; run boot_mmc0"
```

## diy-rockchip_uboot/configs/rk3568_hinlink_h68ktv_defconfig
```kconfig
CONFIG_ARM64=y
CONFIG_ARCH_ROCKCHIP=y
CONFIG_ROCKCHIP_RK3568=y
CONFIG_SYS_SOC="rk3568"
CONFIG_OF_LIBFDT=y
CONFIG_OF_BOARD_SETUP=y
CONFIG_CMD_FDT=y
CONFIG_CMD_EXTENSION=y
CONFIG_SUPPORT_EXTENSION_SCAN=y
CONFIG_SPL_LIBCOMMON_SUPPORT=y
CONFIG_SPL_LIBGENERIC_SUPPORT=y
CONFIG_SPL_FRAMEWORK=y
CONFIG_SPL_MMC=y
CONFIG_SPL_SERIAL=y
CONFIG_SPL_STACK=0x400000
CONFIG_SPL_STACK_R=y
CONFIG_SPL_STACK_R_MALLOC_SIMPLE_LEN=0x100000
CONFIG_SPL_SYS_MALLOC_SIMPLE=y
CONFIG_SPL_ATF=y
CONFIG_SPL_ATF_NO_PLATFORM_PARAM=y
CONFIG_SPL_BOARD_INIT=y
CONFIG_SPL_BSS_START_ADDR=0x4000000
CONFIG_SPL_BSS_MAX_SIZE=0x20000
CONFIG_SYS_MMCSD_RAW_MODE_U_BOOT_SECTOR=0x200
CONFIG_SYS_MMCSD_FS_BOOT_PARTITION=1
CONFIG_SYS_TEXT_BASE=0x00200000
CONFIG_SYS_LOAD_ADDR=0x00080000
CONFIG_SYS_INIT_SP_ADDR=0x400000
CONFIG_NR_DRAM_BANKS=2
CONFIG_DEFAULT_DEVICE_TREE="rk3568-hinlink-h68ktv"
CONFIG_DEBUG_UART=y
CONFIG_DEBUG_UART_BASE=0xfef50000
CONFIG_DEBUG_UART_CLOCK=24000000
CONFIG_DEBUG_UART_SHIFT=2
CONFIG_ENV_SIZE=0x8000
CONFIG_ENV_OFFSET=0x3f8000
CONFIG_ENV_SECT_SIZE=0x10000
CONFIG_CMD_MMC=y
CONFIG_MMC=y
CONFIG_ROCKCHIP_DWMMC=y
CONFIG_ROCKCHIP_SDHCI=y
CONFIG_CMD_USB=y
CONFIG_USB=y
CONFIG_USB_EHCI_HCD=y
CONFIG_USB_OHCI_HCD=y
CONFIG_USB_DWC2=y
CONFIG_USB_STORAGE=y
CONFIG_CMD_NET=y
CONFIG_NET=y
CONFIG_ETH_DESIGNWARE=y
CONFIG_ROCKCHIP_GMAC=y
CONFIG_PHY_GIGE=y
CONFIG_PCI=y
CONFIG_DM_PCI=y
CONFIG_PCIE_DW_ROCKCHIP=y
CONFIG_PHY_ROCKCHIP_SNPS_PCIE3=y
CONFIG_CMD_PCI=y
CONFIG_SYSRESET=y
CONFIG_BOOTDELAY=3
CONFIG_BOOTCOMMAND="pci enum; run boot_usb; run boot_mmc1; run boot_mmc0"
```
